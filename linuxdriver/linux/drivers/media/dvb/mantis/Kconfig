## linuxdriver/linux/drivers/media/dvb/mantis/Kconfig
```kconfig
config DVB_MANTIS
	tristate "MANTIS Support"
	depends on DVB_CORE && PCI && I2C
	help
	  Mantis utility functions for device handling, software fallbacks etc.
	  Say Y when you have a DVB card and want to use it. Say Y if you want
	  to build your drivers outside the kernel, but need the DVB core. All
	  in-kernel drivers will select this automatically if needed.
	  If unsure say N.
```

## linuxdriver/v4l_experimental/firesat/Kconfig
```kconfig
config DVB_FIRESAT
	tristate "FireSAT devices"
	depends on DVB_CORE && ieee1394
	help
	  Support for external IEEE1394 adapters designed by Digital Everywhere and
	  produced by El Gato, shipped under the brand name 'EyeTV 300/400'.

          These devices don't have a MPEG decoder built in, so you need
	  an external software decoder to watch TV.	  

	  Say Y if you own such a device and want to use it.
```
